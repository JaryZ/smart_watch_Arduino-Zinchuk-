#include <DHT.h> /* Підключення бібліотеки для роботи з датчиком вологості і температури DHT */
#define DHTPIN 2 /* Визначення піна, на якому підключено датчик DHT */
#include <Wire.h> /* Підключення бібліотеки для роботи з I2C протоколом */
#include <LiquidCrystal_I2C.h>  /* Підключення бібліотеки для роботи з I2C LCD дисплеєм */
#include <ThreeWire.h>  /* Підключення бібліотеки для використання трьохпровідкового з'єднання до модуля RTC DS1302 */
#include <RtcDS1302.h>  /* Підключення бібліотеки для роботи з модулем реального часу DS1302 */

LiquidCrystal_I2C lcd(0x27, 16, 2);  /* Ініціалізація об'єкту для роботи з LCD дисплеєм */
DHT dht(DHTPIN, DHT11);  /* Ініціалізація об'єкту для роботи з датчиком DHT11 */
ThreeWire myWire(7, 6, 8);  /* Ініціалізація об'єкту для підключення пінів DAT, CLK, RST годинника реального часу DS1302 */
RtcDS1302<ThreeWire> Rtc(myWire);  /* Ініціалізація об'єкту для роботи з модулем реального часу */

int var, test, ns, lt, lt1;  /* Змінні для керування функціоналом */
int soundPin = 12;  /* Пін для виведення звукового сигналу */
int switchPin1 = 3;  /* Пін для першої кнопки */
int switchPin2 = 4;  /* Пін для другої кнопки */
int switchPin3 = 5;  /* Пін для третьої кнопки */
int switchPin4 = 9;  /* Пін для четвертої кнопки */
int switchPin5 = 10;  /* Пін для п'ятої кнопки */
int switchPin6 = 11;  /* Пін для шостої кнопки */
unsigned long startTime = 0;  /* Початковий час для вимірювання інтервалу */
unsigned long allMili = 0;  /* Початковий час для зворотного відліку */
int selectedHour = 0;  /* Змінна для зберігання вибраних годин */
int selectedMinute = 0;  /* Змінна для зберігання вибраних хвилин */
int selectedSecond = 0;  /* Змінна для зберігання вибраних секунд */

void setup() 
{
  Serial.begin(9600);  /* Ініціалізація зв'язку зі зовнішнім пристроєм ( комп'ютером) */
  dht.begin();  /* Ініціалізація датчика DHT */
  lcd.begin();  /* Ініціалізація LCD дисплею */
  delay(1000);  /* Затримка для стабілізації */
  lcd.backlight();  /* Включення підсвічування LCD дисплея */
  Rtc.Begin();  /* Ініціалізація модуля реального часу */
  Rtc.SetIsRunning(true);  /* Запуск модуля реального часу */
  pinMode(switchPin1, INPUT);  /* Встановлення піна для першої кнопки як вхід */
  digitalWrite(switchPin1, HIGH);  /* Підтягування до HIGH для уникнення неправильних сигналів */
  pinMode(switchPin2, INPUT);  /* Встановлення піна для другої кнопки як вхід */
  digitalWrite(switchPin2, HIGH); /* Підтягування до HIGH для уникнення неправильних сигналів */
  pinMode(switchPin3, INPUT); /* Встановлення піна для третьої кнопки як вхід */
  digitalWrite(switchPin3, HIGH); /* Підтягування до HIGH для уникнення неправильних сигналів */
  pinMode(switchPin4, INPUT); /* Встановлення піна для четвертої кнопки як вхід */
  digitalWrite(switchPin4, HIGH); /* Підтягування до HIGH для уникнення неправильних сигналів */
  pinMode(switchPin5, INPUT); /* Встановлення піна для п'ятої кнопки як вхід */
  digitalWrite(switchPin5, HIGH); /* Підтягування до HIGH для уникнення неправильних сигналів */
  pinMode(switchPin6, INPUT); /* Встановлення піна для шостої кнопки як вхід */
  digitalWrite(switchPin6, HIGH); /* Підтягування до HIGH для уникнення неправильних сигналів */
  pinMode(soundPin, OUTPUT);  /* Встановлення піна для звукового сигналу як вихідний */
}

void loop() 
{
  //RtcDateTime newDateTime(2024, 04, 05, 19, 19, 25);
  //Rtc.SetDateTime(newDateTime);
  //кнопка 1: секундомір
  if (digitalRead(switchPin1) == LOW) /* Перевірка на натискання першої кнопки */
  {
    tone(soundPin, 800, 250); /* Відтворення звукового сигналу */
    test=1; /* Вказуємо змінній test значення 1. Це робиться для запуску циклу, який буде відповідати за хід шкали таймера в реальному часі. */
    startTime = millis(); /* Ініціалізація таймера */

    while(test==1) /* Запускаємо цикл */
    {
      lcd.clear(); /* Чистемо інформацію на екрані дисплею */
      lcd.setCursor(0, 0); /* Вказуємо кординату дисплею для виведення інформації */

      unsigned long elapsedTime = millis() - startTime; /* Визначаємо час, який пройшов від початку таймера */
      int minutes = (elapsedTime % 3600000) / 60000; /* Обчислення хвилин */
      int seconds = (elapsedTime % 60000) / 1000; /* Обчислення секунд */
      int milliseconds = elapsedTime % 1000; /* Обчислення мілісекунд */

      /* Форматуємо час для виведення на екран */
      String secondsString = String(seconds < 10 ? "0" + String(seconds) : String(seconds)); /* Перевірка на число, а саме чи воно менше 10. Якщо так, ми виводимо на дисплей це число з 0 поперед собою. В іншому випадку просто виводиться це значення. */
      String minutesString = String(minutes < 10 ? "0" + String(minutes) : String(minutes));  /* Перевірка на число, а саме чи воно менше 10. Якщо так, ми виводимо на дисплей це число з 0 поперед собою. В іншому випадку просто виводиться це значення. */
      String millisecondsString = String(milliseconds < 10 ? "0" + String(milliseconds) : String(milliseconds));  /* Перевірка на число, а саме чи воно менше 10. Якщо так, ми виводимо на дисплей це число з 0 поперед собою. В іншому випадку просто виводиться це значення. */

      lcd.print("Elapsed Time:"); /* виводимо даний текст на верхню частину дисплея. Координати були вказані раніше. */
      lcd.setCursor(0, 1);  /* Вказуємо кординату дисплею для виведення інформації */
      lcd.print(String(minutesString) + "." + String(secondsString) + "." + String(millisecondsString)); /* виводимо пройдений час у іншій половині дисплею. */
      delay(400); /* Оновлюємо інформацію кожні 400 мілісекунд. */

      if (digitalRead(switchPin1) == LOW) /* Перевірка на натискання першої кнопки */
        { 
          tone(soundPin, 800, 250); /* Відтворення звукового сигналу */
          test=0; /* Присвоюємо інше значення. По цій причині секундомір зупиняється (відбувається вихід з циклу). */
          delay(500); /* Оновлюємо інформацію кожні 500 мілісекунд. */
        }
      }
    }

    if (digitalRead(switchPin2) == LOW) /* Перевірка на натискання другої кнопки */
    {
      tone(soundPin, 800, 250); /* Відтворення звукового сигналу */
      selectedHour = (selectedHour + 1) % 24; /* Збільшення години на 1, обмеження до 23 (0-23 години). Значення збільшується при кожному натисканні. */
      lcd.clear(); /* Очищення дисплею */
      String HourString = String(selectedHour < 10 ? "0" + String(selectedHour) : String(selectedHour));/* Перевірка на число, а саме чи воно менше 10. Якщо так, ми виводимо на дисплей це число з 0 поперед собою. В іншому випадку просто виводиться це значення. */
      lcd.setCursor(0, 0); /* Вказуємо координати */
      lcd.print("Hour: "); /* Виводимо текст */
      lcd.print(HourString); /* Виводимо значення вказаної раніше годинни */
      delay(500); /* Оновлюємо інформацію кожні 500 мілісекунд */
    }

    if (digitalRead(switchPin3) == LOW) /* Перевірка на натискання третьої кнопки */
    {
      tone(soundPin, 800, 250); /* Відтворення звукового сигналу */
      selectedMinute = (selectedMinute + 1) % 60; /* Збільшення хвилини на 1, обмеження до 59 (0-59 хвилин) */
      lcd.clear(); /* Очищення дисплею */
      String MinuteString = String(selectedMinute < 10 ? "0" + String(selectedMinute) : String(selectedMinute));  /* Перевірка на число, а саме чи воно менше 10. Якщо так, ми виводимо на дисплей це число з 0 поперед собою. В іншому випадку просто виводиться це значення. */
      lcd.setCursor(0, 0);  /* Вказуємо координати */
      lcd.print("Minute: ");  /* Виводимо текст */
      lcd.print(MinuteString); /* Виводимо значення вказаної раніше хвилини */
      delay(500); /* Оновлюємо інформацію кожні 500 мілісекунд */
    }

    allMili = (selectedHour * 3600) + (selectedMinute * 60); /* Обчислення часу в секундах */
    lt = 1; /* Позначення, що таймер встановлено */

    if (digitalRead(switchPin4) == LOW) /* Перевірка на натискання четвертої кнопки */
    {
      tone(soundPin, 800, 250); /* Відтворення звукового сигналу */
      while(lt == 1) /* Запускаємо цикл */
      {
        lcd.clear(); /* Очищення дисплею */
        int elapsedTime1 = allMili--; /* Зменшення часу */
        int hours = (elapsedTime1 % 86400) / 3600; /* Обчислення годин */
        int minutes = (elapsedTime1 % 3600) / 60; /* Обчислення хвилин */
        int seconds = (elapsedTime1 % 60); /* Обчислення секунд */

        String hoursString1 = String(hours < 10 ? "0" + String(hours) : String(hours));/* Перевірка на число, а саме чи воно менше 10. Якщо так, ми виводимо на дисплей це число з 0 поперед собою. В іншому випадку просто виводиться це значення. */
        String secondsString1 = String(seconds < 10 ? "0" + String(seconds) : String(seconds));/* Перевірка на число, а саме чи воно менше 10. Якщо так, ми виводимо на дисплей це число з 0 поперед собою. В іншому випадку просто виводиться це значення. */
        String minutesString1 = String(minutes < 10 ? "0" + String(minutes) : String(minutes));/* Перевірка на число, а саме чи воно менше 10. Якщо так, ми виводимо на дисплей це число з 0 поперед собою. В іншому випадку просто виводиться це значення. */

        lcd.setCursor(0, 0);  /* Вказуємо координати */
        lcd.print("Timer Time:"); /* Виводимо текст */
        lcd.setCursor(0, 1);  /* Вказуємо координати */
        lcd.print(String(hoursString1) + "." + String(minutesString1) + "." + String(secondsString1));  /* виводимо пройдений час таймеру у іншій половині дисплею. */
        delay(1000);  /* Оновлюємо інформацію кожну секунду */
        if (elapsedTime1 == 0) /* Перевірка на закінчення часу */
        {
          /* Генерація сигналу про закінчення таймера */
          tone(soundPin, 2000, 500); /* Відтворення звукового сигналу */
          delay(1000);  /* пауза на секунду */
          tone(soundPin, 2000, 500);  /* Відтворення звукового сигналу */
          delay(1000);  /* пауза на секунду */
          tone(soundPin, 2000, 500);  /* Відтворення звукового сигналу */
          delay(1000);  /* пауза на секунду */
          tone(soundPin, 2000, 500);  /* Відтворення звукового сигналу */

          lt = 0; /* Зупинка таймера */
          /* Обнулення всіх раніше введених значень. */
          elapsedTime1 = 0;
          selectedHour = 0;
          selectedMinute = 0;
          hours = 0;
          minutes = 0;
          seconds = 0;
          delay(500); /* Оновлюємо інформацію кожні 500 мілісекунд */
        }

        if (digitalRead(switchPin4) == LOW) /* Перевірка на повторне натискання четвертої кнопки */
        {
          tone(soundPin, 800, 250); /* Відтворення звукового сигналу */
          lt = 0; /* Зупинка таймера */
          /* Обнулення всіх раніше введених значень. */
          elapsedTime1 = 0;
          selectedHour = 0;
          selectedMinute = 0;
          hours = 0;
          minutes = 0;
          seconds = 0;
          delay(500); /* Оновлюємо інформацію кожні 500 мілісекунд */
        }
      }
    }
    if (digitalRead(switchPin5) == LOW) /* Перевірка на натискання п'ятої кнопки */
    {
      tone(soundPin, 800, 250); /* Відтворення звукового сигналу */
      lcd.clear(); /* Очищення дисплею */
      ns = 1; /* Вказуємо змінній ns значення 1. Це робиться для запуску циклу. */
      while(ns == 1) /* Запускаємо цикл */
      {
        float h = dht.readHumidity();  /* Зчитування вологості з датчика DHT */
        float t = dht.readTemperature();  /* Зчитування температури з датчика DHT */
        if (isnan(h) || isnan(t))  /* Перевірка на помилку */
        {  
          lcd.print("err"); /* вивід тексту */
          delay (3000); /* оновлювати кожні 3 секунди */
          lcd.clear(); /* Очищення дисплею */
          return;
        }
        else 
        {
          lcd.setCursor(0, 0); /* вказуємо координати */
          lcd.print("temp: "); /* вивід тексту */
          lcd.print(t); /* вивід температури */
          lcd.print(char(223)); /* вивід знака градусів */
          lcd.print("C"); /* вивід тексту */
          lcd.setCursor(0, 1); /* вказуємо координати */
          lcd.print("hum: "); /* вивід тексту */
          lcd.print(h); /* вивід вологості */
          lcd.print(char(37)); /* вивід знака відсотків */
          delay (2000); /* оновлювати давнні кожні 2 секунди */
          lcd.clear(); /* вичищення дисплею */
          if (digitalRead(switchPin1) == LOW) /* Перевірка на натискання першої кнопки */
          { 
            ns = 0; /* вихід з циклу */
          }
          if (digitalRead(switchPin2) == LOW) /* Перевірка на натискання другої кнопки */
          {
            ns = 0; /* вихід з циклу */      
          }
          if (digitalRead(switchPin3) == LOW) /* Перевірка на натискання третьої кнопки */
          { 
            ns = 0; /* вихід з циклу */   
          }
          if (digitalRead(switchPin4) == LOW) /* Перевірка на натискання четверту кнопки */
          { 
            ns = 0; /* вихід з циклу */
          }
          if (digitalRead(switchPin6) == LOW) /* Перевірка на натискання шостої кнопки */
          { 
            ns = 0; /* вихід з циклу */
          }
        }
      }
    }
    if (digitalRead(switchPin6) == LOW) /* Перевірка на натискання шостої кнопки */
    {
      tone(soundPin, 800, 250); /* Відтворення звукового сигналу */
      lcd.clear(); /* Очищення дисплею */
    var = 1; /* значення для старту циклу */
    while(var == 1) /* запуск циклу */
    {
      RtcDateTime now = Rtc.GetDateTime();  /* Отримання поточної дати та часу з модуля RTC */
      int hour = now.Hour(); /* введеня години */
      int minute = now.Minute(); /* введення хвилини */
      int second = now.Second(); /* введеня секунди */
      int year = now.Year(); /* введеня року */
      int month = now.Month(); /* введення місяця */
      int day = now.Day(); /* введення дня */

      String hourString = String(hour < 10 ? "0" + String(hour) : String(hour));/* Перевірка на число, а саме чи воно менше 10. Якщо так, ми виводимо на дисплей це число з 0 поперед собою. В іншому випадку просто виводиться це значення. */
      String minuteString = String(minute < 10 ? "0" + String(minute) : String(minute));/* Перевірка на число, а саме чи воно менше 10. Якщо так, ми виводимо на дисплей це число з 0 поперед собою. В іншому випадку просто виводиться це значення. */
      String secondString = String(second < 10 ? "0" + String(second) : String(second));/* Перевірка на число, а саме чи воно менше 10. Якщо так, ми виводимо на дисплей це число з 0 поперед собою. В іншому випадку просто виводиться це значення. */
      String monthString = String(month < 10 ? "0" + String(month) : String(month));/* Перевірка на число, а саме чи воно менше 10. Якщо так, ми виводимо на дисплей це число з 0 поперед собою. В іншому випадку просто виводиться це значення. */
      String dayString = String(day < 10 ? "0" + String(day) : String(day));/* Перевірка на число, а саме чи воно менше 10. Якщо так, ми виводимо на дисплей це число з 0 поперед собою. В іншому випадку просто виводиться це значення. */

      String dateString = String(dayString) + "/" + String(monthString) + "/" + String(year); /* розтановка значень для ввиводу */
      String timeString = String(hourString) + ":" + String(minuteString) + ":" + String(secondString); /* розтановка значень для ввиводу */
      lcd.setCursor(0, 0); /* вибід координати */
      lcd.print("Date: "); /* вивід тексту */
      lcd.print(dateString); /* вивід дати */
      lcd.setCursor(0, 1); /* вибір координати */
      lcd.print("Time: "); /* вивід тексту */
      lcd.print(timeString); /* вивід часу */
      delay(1000); /* оновлювати щосекундно */
      lcd.clear(); /* Очищення дисплею */
      if (digitalRead(switchPin1) == LOW) /* Перевірка на натискання першої кнопки */
      {
        var = 0; /* вихід з циклу */
      }
      if (digitalRead(switchPin2) == LOW) /* Перевірка на натискання другої кнопки */
      {
        var = 0; /* вихід з циклу */ 
      }
      if (digitalRead(switchPin3) == LOW) /* Перевірка на натискання третьої кнопки */
      { 
        var = 0; /* вихід з циклу */
      }
      if (digitalRead(switchPin4) == LOW) /* Перевірка на натискання четвертої кнопки */
      { 
        var = 0; /* вихід з циклу */
      }
      if (digitalRead(switchPin5) == LOW) /* Перевірка на натискання п'ятої кнопки */
      { 
        var = 0; /* вихід з циклу */
      }
    }
  }
}
